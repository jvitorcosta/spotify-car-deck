// Generated by tools/gen_dex.py from PokeAPI CSV data. Do not edit.
static const char* const TYPE_NAMES[] = {
    "normal",
    "fighting",
    "flying",
    "poison",
    "ground",
    "rock",
    "bug",
    "ghost",
    "steel",
    "fire",
    "water",
    "grass",
    "electric",
    "psychic",
    "ice",
    "dragon",
    "dark",
    "fairy",
};
static const DexEntry DEX[1025] = {
    {"Bulbasaur", 11},
    {"Ivysaur", 11},
    {"Venusaur", 11},
    {"Charmander", 9},
    {"Charmeleon", 9},
    {"Charizard", 9},
    {"Squirtle", 10},
    {"Wartortle", 10},
    {"Blastoise", 10},
    {"Caterpie", 6},
    {"Metapod", 6},
    {"Butterfree", 6},
    {"Weedle", 6},
    {"Kakuna", 6},
    {"Beedrill", 6},
    {"Pidgey", 0},
    {"Pidgeotto", 0},
    {"Pidgeot", 0},
    {"Rattata", 0},
    {"Raticate", 0},
    {"Spearow", 0},
    {"Fearow", 0},
    {"Ekans", 3},
    {"Arbok", 3},
    {"Pikachu", 12},
    {"Raichu", 12},
    {"Sandshrew", 4},
    {"Sandslash", 4},
    {"Nidoran F", 3},
    {"Nidorina", 3},
    {"Nidoqueen", 3},
    {"Nidoran M", 3},
    {"Nidorino", 3},
    {"Nidoking", 3},
    {"Clefairy", 17},
    {"Clefable", 17},
    {"Vulpix", 9},
    {"Ninetales", 9},
    {"Jigglypuff", 0},
    {"Wigglytuff", 0},
    {"Zubat", 3},
    {"Golbat", 3},
    {"Oddish", 11},
    {"Gloom", 11},
    {"Vileplume", 11},
    {"Paras", 6},
    {"Parasect", 6},
    {"Venonat", 6},
    {"Venomoth", 6},
    {"Diglett", 4},
    {"Dugtrio", 4},
    {"Meowth", 0},
    {"Persian", 0},
    {"Psyduck", 10},
    {"Golduck", 10},
    {"Mankey", 1},
    {"Primeape", 1},
    {"Growlithe", 9},
    {"Arcanine", 9},
    {"Poliwag", 10},
    {"Poliwhirl", 10},
    {"Poliwrath", 10},
    {"Abra", 13},
    {"Kadabra", 13},
    {"Alakazam", 13},
    {"Machop", 1},
    {"Machoke", 1},
    {"Machamp", 1},
    {"Bellsprout", 11},
    {"Weepinbell", 11},
    {"Victreebel", 11},
    {"Tentacool", 10},
    {"Tentacruel", 10},
    {"Geodude", 5},
    {"Graveler", 5},
    {"Golem", 5},
    {"Ponyta", 9},
    {"Rapidash", 9},
    {"Slowpoke", 10},
    {"Slowbro", 10},
    {"Magnemite", 12},
    {"Magneton", 12},
    {"Farfetch'd", 0},
    {"Doduo", 0},
    {"Dodrio", 0},
    {"Seel", 10},
    {"Dewgong", 10},
    {"Grimer", 3},
    {"Muk", 3},
    {"Shellder", 10},
    {"Cloyster", 10},
    {"Gastly", 7},
    {"Haunter", 7},
    {"Gengar", 7},
    {"Onix", 5},
    {"Drowzee", 13},
    {"Hypno", 13},
    {"Krabby", 10},
    {"Kingler", 10},
    {"Voltorb", 12},
    {"Electrode", 12},
    {"Exeggcute", 11},
    {"Exeggutor", 11},
    {"Cubone", 4},
    {"Marowak", 4},
    {"Hitmonlee", 1},
    {"Hitmonchan", 1},
    {"Lickitung", 0},
    {"Koffing", 3},
    {"Weezing", 3},
    {"Rhyhorn", 4},
    {"Rhydon", 4},
    {"Chansey", 0},
    {"Tangela", 11},
    {"Kangaskhan", 0},
    {"Horsea", 10},
    {"Seadra", 10},
    {"Goldeen", 10},
    {"Seaking", 10},
    {"Staryu", 10},
    {"Starmie", 10},
    {"Mr. Mime", 13},
    {"Scyther", 6},
    {"Jynx", 14},
    {"Electabuzz", 12},
    {"Magmar", 9},
    {"Pinsir", 6},
    {"Tauros", 0},
    {"Magikarp", 10},
    {"Gyarados", 10},
    {"Lapras", 10},
    {"Ditto", 0},
    {"Eevee", 0},
    {"Vaporeon", 10},
    {"Jolteon", 12},
    {"Flareon", 9},
    {"Porygon", 0},
    {"Omanyte", 5},
    {"Omastar", 5},
    {"Kabuto", 5},
    {"Kabutops", 5},
    {"Aerodactyl", 5},
    {"Snorlax", 0},
    {"Articuno", 14},
    {"Zapdos", 12},
    {"Moltres", 9},
    {"Dratini", 15},
    {"Dragonair", 15},
    {"Dragonite", 15},
    {"Mewtwo", 13},
    {"Mew", 13},
    {"Chikorita", 11},
    {"Bayleef", 11},
    {"Meganium", 11},
    {"Cyndaquil", 9},
    {"Quilava", 9},
    {"Typhlosion", 9},
    {"Totodile", 10},
    {"Croconaw", 10},
    {"Feraligatr", 10},
    {"Sentret", 0},
    {"Furret", 0},
    {"Hoothoot", 0},
    {"Noctowl", 0},
    {"Ledyba", 6},
    {"Ledian", 6},
    {"Spinarak", 6},
    {"Ariados", 6},
    {"Crobat", 3},
    {"Chinchou", 10},
    {"Lanturn", 10},
    {"Pichu", 12},
    {"Cleffa", 17},
    {"Igglybuff", 0},
    {"Togepi", 17},
    {"Togetic", 17},
    {"Natu", 13},
    {"Xatu", 13},
    {"Mareep", 12},
    {"Flaaffy", 12},
    {"Ampharos", 12},
    {"Bellossom", 11},
    {"Marill", 10},
    {"Azumarill", 10},
    {"Sudowoodo", 5},
    {"Politoed", 10},
    {"Hoppip", 11},
    {"Skiploom", 11},
    {"Jumpluff", 11},
    {"Aipom", 0},
    {"Sunkern", 11},
    {"Sunflora", 11},
    {"Yanma", 6},
    {"Wooper", 10},
    {"Quagsire", 10},
    {"Espeon", 13},
    {"Umbreon", 16},
    {"Murkrow", 16},
    {"Slowking", 10},
    {"Misdreavus", 7},
    {"Unown", 13},
    {"Wobbuffet", 13},
    {"Girafarig", 0},
    {"Pineco", 6},
    {"Forretress", 6},
    {"Dunsparce", 0},
    {"Gligar", 4},
    {"Steelix", 8},
    {"Snubbull", 17},
    {"Granbull", 17},
    {"Qwilfish", 10},
    {"Scizor", 6},
    {"Shuckle", 6},
    {"Heracross", 6},
    {"Sneasel", 16},
    {"Teddiursa", 0},
    {"Ursaring", 0},
    {"Slugma", 9},
    {"Magcargo", 9},
    {"Swinub", 14},
    {"Piloswine", 14},
    {"Corsola", 10},
    {"Remoraid", 10},
    {"Octillery", 10},
    {"Delibird", 14},
    {"Mantine", 10},
    {"Skarmory", 8},
    {"Houndour", 16},
    {"Houndoom", 16},
    {"Kingdra", 10},
    {"Phanpy", 4},
    {"Donphan", 4},
    {"Porygon2", 0},
    {"Stantler", 0},
    {"Smeargle", 0},
    {"Tyrogue", 1},
    {"Hitmontop", 1},
    {"Smoochum", 14},
    {"Elekid", 12},
    {"Magby", 9},
    {"Miltank", 0},
    {"Blissey", 0},
    {"Raikou", 12},
    {"Entei", 9},
    {"Suicune", 10},
    {"Larvitar", 5},
    {"Pupitar", 5},
    {"Tyranitar", 5},
    {"Lugia", 13},
    {"Ho-Oh", 9},
    {"Celebi", 13},
    {"Treecko", 11},
    {"Grovyle", 11},
    {"Sceptile", 11},
    {"Torchic", 9},
    {"Combusken", 9},
    {"Blaziken", 9},
    {"Mudkip", 10},
    {"Marshtomp", 10},
    {"Swampert", 10},
    {"Poochyena", 16},
    {"Mightyena", 16},
    {"Zigzagoon", 0},
    {"Linoone", 0},
    {"Wurmple", 6},
    {"Silcoon", 6},
    {"Beautifly", 6},
    {"Cascoon", 6},
    {"Dustox", 6},
    {"Lotad", 10},
    {"Lombre", 10},
    {"Ludicolo", 10},
    {"Seedot", 11},
    {"Nuzleaf", 11},
    {"Shiftry", 11},
    {"Taillow", 0},
    {"Swellow", 0},
    {"Wingull", 10},
    {"Pelipper", 10},
    {"Ralts", 13},
    {"Kirlia", 13},
    {"Gardevoir", 13},
    {"Surskit", 6},
    {"Masquerain", 6},
    {"Shroomish", 11},
    {"Breloom", 11},
    {"Slakoth", 0},
    {"Vigoroth", 0},
    {"Slaking", 0},
    {"Nincada", 6},
    {"Ninjask", 6},
    {"Shedinja", 6},
    {"Whismur", 0},
    {"Loudred", 0},
    {"Exploud", 0},
    {"Makuhita", 1},
    {"Hariyama", 1},
    {"Azurill", 0},
    {"Nosepass", 5},
    {"Skitty", 0},
    {"Delcatty", 0},
    {"Sableye", 16},
    {"Mawile", 8},
    {"Aron", 8},
    {"Lairon", 8},
    {"Aggron", 8},
    {"Meditite", 1},
    {"Medicham", 1},
    {"Electrike", 12},
    {"Manectric", 12},
    {"Plusle", 12},
    {"Minun", 12},
    {"Volbeat", 6},
    {"Illumise", 6},
    {"Roselia", 11},
    {"Gulpin", 3},
    {"Swalot", 3},
    {"Carvanha", 10},
    {"Sharpedo", 10},
    {"Wailmer", 10},
    {"Wailord", 10},
    {"Numel", 9},
    {"Camerupt", 9},
    {"Torkoal", 9},
    {"Spoink", 13},
    {"Grumpig", 13},
    {"Spinda", 0},
    {"Trapinch", 4},
    {"Vibrava", 4},
    {"Flygon", 4},
    {"Cacnea", 11},
    {"Cacturne", 11},
    {"Swablu", 0},
    {"Altaria", 15},
    {"Zangoose", 0},
    {"Seviper", 3},
    {"Lunatone", 5},
    {"Solrock", 5},
    {"Barboach", 10},
    {"Whiscash", 10},
    {"Corphish", 10},
    {"Crawdaunt", 10},
    {"Baltoy", 4},
    {"Claydol", 4},
    {"Lileep", 5},
    {"Cradily", 5},
    {"Anorith", 5},
    {"Armaldo", 5},
    {"Feebas", 10},
    {"Milotic", 10},
    {"Castform", 0},
    {"Kecleon", 0},
    {"Shuppet", 7},
    {"Banette", 7},
    {"Duskull", 7},
    {"Dusclops", 7},
    {"Tropius", 11},
    {"Chimecho", 13},
    {"Absol", 16},
    {"Wynaut", 13},
    {"Snorunt", 14},
    {"Glalie", 14},
    {"Spheal", 14},
    {"Sealeo", 14},
    {"Walrein", 14},
    {"Clamperl", 10},
    {"Huntail", 10},
    {"Gorebyss", 10},
    {"Relicanth", 10},
    {"Luvdisc", 10},
    {"Bagon", 15},
    {"Shelgon", 15},
    {"Salamence", 15},
    {"Beldum", 8},
    {"Metang", 8},
    {"Metagross", 8},
    {"Regirock", 5},
    {"Regice", 14},
    {"Registeel", 8},
    {"Latias", 15},
    {"Latios", 15},
    {"Kyogre", 10},
    {"Groudon", 4},
    {"Rayquaza", 15},
    {"Jirachi", 8},
    {"Deoxys", 13},
    {"Turtwig", 11},
    {"Grotle", 11},
    {"Torterra", 11},
    {"Chimchar", 9},
    {"Monferno", 9},
    {"Infernape", 9},
    {"Piplup", 10},
    {"Prinplup", 10},
    {"Empoleon", 10},
    {"Starly", 0},
    {"Staravia", 0},
    {"Staraptor", 0},
    {"Bidoof", 0},
    {"Bibarel", 0},
    {"Kricketot", 6},
    {"Kricketune", 6},
    {"Shinx", 12},
    {"Luxio", 12},
    {"Luxray", 12},
    {"Budew", 11},
    {"Roserade", 11},
    {"Cranidos", 5},
    {"Rampardos", 5},
    {"Shieldon", 5},
    {"Bastiodon", 5},
    {"Burmy", 6},
    {"Wormadam", 6},
    {"Mothim", 6},
    {"Combee", 6},
    {"Vespiquen", 6},
    {"Pachirisu", 12},
    {"Buizel", 10},
    {"Floatzel", 10},
    {"Cherubi", 11},
    {"Cherrim", 11},
    {"Shellos", 10},
    {"Gastrodon", 10},
    {"Ambipom", 0},
    {"Drifloon", 7},
    {"Drifblim", 7},
    {"Buneary", 0},
    {"Lopunny", 0},
    {"Mismagius", 7},
    {"Honchkrow", 16},
    {"Glameow", 0},
    {"Purugly", 0},
    {"Chingling", 13},
    {"Stunky", 3},
    {"Skuntank", 3},
    {"Bronzor", 8},
    {"Bronzong", 8},
    {"Bonsly", 5},
    {"Mime Jr.", 13},
    {"Happiny", 0},
    {"Chatot", 0},
    {"Spiritomb", 7},
    {"Gible", 15},
    {"Gabite", 15},
    {"Garchomp", 15},
    {"Munchlax", 0},
    {"Riolu", 1},
    {"Lucario", 1},
    {"Hippopotas", 4},
    {"Hippowdon", 4},
    {"Skorupi", 3},
    {"Drapion", 3},
    {"Croagunk", 3},
    {"Toxicroak", 3},
    {"Carnivine", 11},
    {"Finneon", 10},
    {"Lumineon", 10},
    {"Mantyke", 10},
    {"Snover", 11},
    {"Abomasnow", 11},
    {"Weavile", 16},
    {"Magnezone", 12},
    {"Lickilicky", 0},
    {"Rhyperior", 4},
    {"Tangrowth", 11},
    {"Electivire", 12},
    {"Magmortar", 9},
    {"Togekiss", 17},
    {"Yanmega", 6},
    {"Leafeon", 11},
    {"Glaceon", 14},
    {"Gliscor", 4},
    {"Mamoswine", 14},
    {"Porygon-Z", 0},
    {"Gallade", 13},
    {"Probopass", 5},
    {"Dusknoir", 7},
    {"Froslass", 14},
    {"Rotom", 12},
    {"Uxie", 13},
    {"Mesprit", 13},
    {"Azelf", 13},
    {"Dialga", 8},
    {"Palkia", 10},
    {"Heatran", 9},
    {"Regigigas", 0},
    {"Giratina", 7},
    {"Cresselia", 13},
    {"Phione", 10},
    {"Manaphy", 10},
    {"Darkrai", 16},
    {"Shaymin", 11},
    {"Arceus", 0},
    {"Victini", 13},
    {"Snivy", 11},
    {"Servine", 11},
    {"Serperior", 11},
    {"Tepig", 9},
    {"Pignite", 9},
    {"Emboar", 9},
    {"Oshawott", 10},
    {"Dewott", 10},
    {"Samurott", 10},
    {"Patrat", 0},
    {"Watchog", 0},
    {"Lillipup", 0},
    {"Herdier", 0},
    {"Stoutland", 0},
    {"Purrloin", 16},
    {"Liepard", 16},
    {"Pansage", 11},
    {"Simisage", 11},
    {"Pansear", 9},
    {"Simisear", 9},
    {"Panpour", 10},
    {"Simipour", 10},
    {"Munna", 13},
    {"Musharna", 13},
    {"Pidove", 0},
    {"Tranquill", 0},
    {"Unfezant", 0},
    {"Blitzle", 12},
    {"Zebstrika", 12},
    {"Roggenrola", 5},
    {"Boldore", 5},
    {"Gigalith", 5},
    {"Woobat", 13},
    {"Swoobat", 13},
    {"Drilbur", 4},
    {"Excadrill", 4},
    {"Audino", 0},
    {"Timburr", 1},
    {"Gurdurr", 1},
    {"Conkeldurr", 1},
    {"Tympole", 10},
    {"Palpitoad", 10},
    {"Seismitoad", 10},
    {"Throh", 1},
    {"Sawk", 1},
    {"Sewaddle", 6},
    {"Swadloon", 6},
    {"Leavanny", 6},
    {"Venipede", 6},
    {"Whirlipede", 6},
    {"Scolipede", 6},
    {"Cottonee", 11},
    {"Whimsicott", 11},
    {"Petilil", 11},
    {"Lilligant", 11},
    {"Basculin", 10},
    {"Sandile", 4},
    {"Krokorok", 4},
    {"Krookodile", 4},
    {"Darumaka", 9},
    {"Darmanitan", 9},
    {"Maractus", 11},
    {"Dwebble", 6},
    {"Crustle", 6},
    {"Scraggy", 16},
    {"Scrafty", 16},
    {"Sigilyph", 13},
    {"Yamask", 7},
    {"Cofagrigus", 7},
    {"Tirtouga", 10},
    {"Carracosta", 10},
    {"Archen", 5},
    {"Archeops", 5},
    {"Trubbish", 3},
    {"Garbodor", 3},
    {"Zorua", 16},
    {"Zoroark", 16},
    {"Minccino", 0},
    {"Cinccino", 0},
    {"Gothita", 13},
    {"Gothorita", 13},
    {"Gothitelle", 13},
    {"Solosis", 13},
    {"Duosion", 13},
    {"Reuniclus", 13},
    {"Ducklett", 10},
    {"Swanna", 10},
    {"Vanillite", 14},
    {"Vanillish", 14},
    {"Vanilluxe", 14},
    {"Deerling", 0},
    {"Sawsbuck", 0},
    {"Emolga", 12},
    {"Karrablast", 6},
    {"Escavalier", 6},
    {"Foongus", 11},
    {"Amoonguss", 11},
    {"Frillish", 10},
    {"Jellicent", 10},
    {"Alomomola", 10},
    {"Joltik", 6},
    {"Galvantula", 6},
    {"Ferroseed", 11},
    {"Ferrothorn", 11},
    {"Klink", 8},
    {"Klang", 8},
    {"Klinklang", 8},
    {"Tynamo", 12},
    {"Eelektrik", 12},
    {"Eelektross", 12},
    {"Elgyem", 13},
    {"Beheeyem", 13},
    {"Litwick", 7},
    {"Lampent", 7},
    {"Chandelure", 7},
    {"Axew", 15},
    {"Fraxure", 15},
    {"Haxorus", 15},
    {"Cubchoo", 14},
    {"Beartic", 14},
    {"Cryogonal", 14},
    {"Shelmet", 6},
    {"Accelgor", 6},
    {"Stunfisk", 4},
    {"Mienfoo", 1},
    {"Mienshao", 1},
    {"Druddigon", 15},
    {"Golett", 4},
    {"Golurk", 4},
    {"Pawniard", 16},
    {"Bisharp", 16},
    {"Bouffalant", 0},
    {"Rufflet", 0},
    {"Braviary", 0},
    {"Vullaby", 16},
    {"Mandibuzz", 16},
    {"Heatmor", 9},
    {"Durant", 6},
    {"Deino", 16},
    {"Zweilous", 16},
    {"Hydreigon", 16},
    {"Larvesta", 6},
    {"Volcarona", 6},
    {"Cobalion", 8},
    {"Terrakion", 5},
    {"Virizion", 11},
    {"Tornadus", 2},
    {"Thundurus", 12},
    {"Reshiram", 15},
    {"Zekrom", 15},
    {"Landorus", 4},
    {"Kyurem", 15},
    {"Keldeo", 10},
    {"Meloetta", 0},
    {"Genesect", 6},
    {"Chespin", 11},
    {"Quilladin", 11},
    {"Chesnaught", 11},
    {"Fennekin", 9},
    {"Braixen", 9},
    {"Delphox", 9},
    {"Froakie", 10},
    {"Frogadier", 10},
    {"Greninja", 10},
    {"Bunnelby", 0},
    {"Diggersby", 0},
    {"Fletchling", 0},
    {"Fletchinder", 9},
    {"Talonflame", 9},
    {"Scatterbug", 6},
    {"Spewpa", 6},
    {"Vivillon", 6},
    {"Litleo", 9},
    {"Pyroar", 9},
    {"Flabebe", 17},
    {"Floette", 17},
    {"Florges", 17},
    {"Skiddo", 11},
    {"Gogoat", 11},
    {"Pancham", 1},
    {"Pangoro", 1},
    {"Furfrou", 0},
    {"Espurr", 13},
    {"Meowstic", 13},
    {"Honedge", 8},
    {"Doublade", 8},
    {"Aegislash", 8},
    {"Spritzee", 17},
    {"Aromatisse", 17},
    {"Swirlix", 17},
    {"Slurpuff", 17},
    {"Inkay", 16},
    {"Malamar", 16},
    {"Binacle", 5},
    {"Barbaracle", 5},
    {"Skrelp", 3},
    {"Dragalge", 3},
    {"Clauncher", 10},
    {"Clawitzer", 10},
    {"Helioptile", 12},
    {"Heliolisk", 12},
    {"Tyrunt", 5},
    {"Tyrantrum", 5},
    {"Amaura", 5},
    {"Aurorus", 5},
    {"Sylveon", 17},
    {"Hawlucha", 1},
    {"Dedenne", 12},
    {"Carbink", 5},
    {"Goomy", 15},
    {"Sliggoo", 15},
    {"Goodra", 15},
    {"Klefki", 8},
    {"Phantump", 7},
    {"Trevenant", 7},
    {"Pumpkaboo", 7},
    {"Gourgeist", 7},
    {"Bergmite", 14},
    {"Avalugg", 14},
    {"Noibat", 2},
    {"Noivern", 2},
    {"Xerneas", 17},
    {"Yveltal", 16},
    {"Zygarde", 15},
    {"Diancie", 5},
    {"Hoopa", 13},
    {"Volcanion", 9},
    {"Rowlet", 11},
    {"Dartrix", 11},
    {"Decidueye", 11},
    {"Litten", 9},
    {"Torracat", 9},
    {"Incineroar", 9},
    {"Popplio", 10},
    {"Brionne", 10},
    {"Primarina", 10},
    {"Pikipek", 0},
    {"Trumbeak", 0},
    {"Toucannon", 0},
    {"Yungoos", 0},
    {"Gumshoos", 0},
    {"Grubbin", 6},
    {"Charjabug", 6},
    {"Vikavolt", 6},
    {"Crabrawler", 1},
    {"Crabominable", 1},
    {"Oricorio", 9},
    {"Cutiefly", 6},
    {"Ribombee", 6},
    {"Rockruff", 5},
    {"Lycanroc", 5},
    {"Wishiwashi", 10},
    {"Mareanie", 3},
    {"Toxapex", 3},
    {"Mudbray", 4},
    {"Mudsdale", 4},
    {"Dewpider", 10},
    {"Araquanid", 10},
    {"Fomantis", 11},
    {"Lurantis", 11},
    {"Morelull", 11},
    {"Shiinotic", 11},
    {"Salandit", 3},
    {"Salazzle", 3},
    {"Stufful", 0},
    {"Bewear", 0},
    {"Bounsweet", 11},
    {"Steenee", 11},
    {"Tsareena", 11},
    {"Comfey", 17},
    {"Oranguru", 0},
    {"Passimian", 1},
    {"Wimpod", 6},
    {"Golisopod", 6},
    {"Sandygast", 7},
    {"Palossand", 7},
    {"Pyukumuku", 10},
    {"Type: Null", 0},
    {"Silvally", 0},
    {"Minior", 5},
    {"Komala", 0},
    {"Turtonator", 9},
    {"Togedemaru", 12},
    {"Mimikyu", 7},
    {"Bruxish", 10},
    {"Drampa", 0},
    {"Dhelmise", 7},
    {"Jangmo-o", 15},
    {"Hakamo-o", 15},
    {"Kommo-o", 15},
    {"Tapu Koko", 12},
    {"Tapu Lele", 13},
    {"Tapu Bulu", 11},
    {"Tapu Fini", 10},
    {"Cosmog", 13},
    {"Cosmoem", 13},
    {"Solgaleo", 13},
    {"Lunala", 13},
    {"Nihilego", 5},
    {"Buzzwole", 6},
    {"Pheromosa", 6},
    {"Xurkitree", 12},
    {"Celesteela", 8},
    {"Kartana", 11},
    {"Guzzlord", 16},
    {"Necrozma", 13},
    {"Magearna", 8},
    {"Marshadow", 1},
    {"Poipole", 3},
    {"Naganadel", 3},
    {"Stakataka", 5},
    {"Blacephalon", 9},
    {"Zeraora", 12},
    {"Meltan", 8},
    {"Melmetal", 8},
    {"Grookey", 11},
    {"Thwackey", 11},
    {"Rillaboom", 11},
    {"Scorbunny", 9},
    {"Raboot", 9},
    {"Cinderace", 9},
    {"Sobble", 10},
    {"Drizzile", 10},
    {"Inteleon", 10},
    {"Skwovet", 0},
    {"Greedent", 0},
    {"Rookidee", 2},
    {"Corvisquire", 2},
    {"Corviknight", 2},
    {"Blipbug", 6},
    {"Dottler", 6},
    {"Orbeetle", 6},
    {"Nickit", 16},
    {"Thievul", 16},
    {"Gossifleur", 11},
    {"Eldegoss", 11},
    {"Wooloo", 0},
    {"Dubwool", 0},
    {"Chewtle", 10},
    {"Drednaw", 10},
    {"Yamper", 12},
    {"Boltund", 12},
    {"Rolycoly", 5},
    {"Carkol", 5},
    {"Coalossal", 5},
    {"Applin", 11},
    {"Flapple", 11},
    {"Appletun", 11},
    {"Silicobra", 4},
    {"Sandaconda", 4},
    {"Cramorant", 2},
    {"Arrokuda", 10},
    {"Barraskewda", 10},
    {"Toxel", 12},
    {"Toxtricity", 12},
    {"Sizzlipede", 9},
    {"Centiskorch", 9},
    {"Clobbopus", 1},
    {"Grapploct", 1},
    {"Sinistea", 7},
    {"Polteageist", 7},
    {"Hatenna", 13},
    {"Hattrem", 13},
    {"Hatterene", 13},
    {"Impidimp", 16},
    {"Morgrem", 16},
    {"Grimmsnarl", 16},
    {"Obstagoon", 16},
    {"Perrserker", 8},
    {"Cursola", 7},
    {"Sirfetch'd", 1},
    {"Mr. Rime", 14},
    {"Runerigus", 4},
    {"Milcery", 17},
    {"Alcremie", 17},
    {"Falinks", 1},
    {"Pincurchin", 12},
    {"Snom", 14},
    {"Frosmoth", 14},
    {"Stonjourner", 5},
    {"Eiscue", 14},
    {"Indeedee", 13},
    {"Morpeko", 12},
    {"Cufant", 8},
    {"Copperajah", 8},
    {"Dracozolt", 12},
    {"Arctozolt", 12},
    {"Dracovish", 10},
    {"Arctovish", 10},
    {"Duraludon", 8},
    {"Dreepy", 15},
    {"Drakloak", 15},
    {"Dragapult", 15},
    {"Zacian", 17},
    {"Zamazenta", 1},
    {"Eternatus", 3},
    {"Kubfu", 1},
    {"Urshifu", 1},
    {"Zarude", 16},
    {"Regieleki", 12},
    {"Regidrago", 15},
    {"Glastrier", 14},
    {"Spectrier", 7},
    {"Calyrex", 13},
    {"Wyrdeer", 0},
    {"Kleavor", 6},
    {"Ursaluna", 4},
    {"Basculegion", 10},
    {"Sneasler", 1},
    {"Overqwil", 16},
    {"Enamorus", 17},
    {"Sprigatito", 11},
    {"Floragato", 11},
    {"Meowscarada", 11},
    {"Fuecoco", 9},
    {"Crocalor", 9},
    {"Skeledirge", 9},
    {"Quaxly", 10},
    {"Quaxwell", 10},
    {"Quaquaval", 10},
    {"Lechonk", 0},
    {"Oinkologne", 0},
    {"Tarountula", 6},
    {"Spidops", 6},
    {"Nymble", 6},
    {"Lokix", 6},
    {"Pawmi", 12},
    {"Pawmo", 12},
    {"Pawmot", 12},
    {"Tandemaus", 0},
    {"Maushold", 0},
    {"Fidough", 17},
    {"Dachsbun", 17},
    {"Smoliv", 11},
    {"Dolliv", 11},
    {"Arboliva", 11},
    {"Squawkabilly", 0},
    {"Nacli", 5},
    {"Naclstack", 5},
    {"Garganacl", 5},
    {"Charcadet", 9},
    {"Armarouge", 9},
    {"Ceruledge", 9},
    {"Tadbulb", 12},
    {"Bellibolt", 12},
    {"Wattrel", 12},
    {"Kilowattrel", 12},
    {"Maschiff", 16},
    {"Mabosstiff", 16},
    {"Shroodle", 3},
    {"Grafaiai", 3},
    {"Bramblin", 11},
    {"Brambleghast", 11},
    {"Toedscool", 4},
    {"Toedscruel", 4},
    {"Klawf", 5},
    {"Capsakid", 11},
    {"Scovillain", 11},
    {"Rellor", 6},
    {"Rabsca", 6},
    {"Flittle", 13},
    {"Espathra", 13},
    {"Tinkatink", 17},
    {"Tinkatuff", 17},
    {"Tinkaton", 17},
    {"Wiglett", 10},
    {"Wugtrio", 10},
    {"Bombirdier", 2},
    {"Finizen", 10},
    {"Palafin", 10},
    {"Varoom", 8},
    {"Revavroom", 8},
    {"Cyclizar", 15},
    {"Orthworm", 8},
    {"Glimmet", 5},
    {"Glimmora", 5},
    {"Greavard", 7},
    {"Houndstone", 7},
    {"Flamigo", 2},
    {"Cetoddle", 14},
    {"Cetitan", 14},
    {"Veluza", 10},
    {"Dondozo", 10},
    {"Tatsugiri", 15},
    {"Annihilape", 1},
    {"Clodsire", 3},
    {"Farigiraf", 0},
    {"Dudunsparce", 0},
    {"Kingambit", 16},
    {"Great Tusk", 4},
    {"Scream Tail", 17},
    {"Brute Bonnet", 11},
    {"Flutter Mane", 7},
    {"Slither Wing", 6},
    {"Sandy Shocks", 12},
    {"Iron Treads", 4},
    {"Iron Bundle", 14},
    {"Iron Hands", 1},
    {"Iron Jugulis", 16},
    {"Iron Moth", 9},
    {"Iron Thorns", 5},
    {"Frigibax", 15},
    {"Arctibax", 15},
    {"Baxcalibur", 15},
    {"Gimmighoul", 7},
    {"Gholdengo", 8},
    {"Wo-Chien", 16},
    {"Chien-Pao", 16},
    {"Ting-Lu", 16},
    {"Chi-Yu", 16},
    {"Roaring Moon", 15},
    {"Iron Valiant", 17},
    {"Koraidon", 1},
    {"Miraidon", 12},
    {"Walking Wake", 10},
    {"Iron Leaves", 11},
    {"Dipplin", 11},
    {"Poltchageist", 11},
    {"Sinistcha", 11},
    {"Okidogi", 3},
    {"Munkidori", 3},
    {"Fezandipiti", 3},
    {"Ogerpon", 11},
    {"Archaludon", 8},
    {"Hydrapple", 11},
    {"Gouging Fire", 9},
    {"Raging Bolt", 12},
    {"Iron Boulder", 5},
    {"Iron Crown", 8},
    {"Terapagos", 0},
    {"Pecharunt", 3},
};
